## esp32_scansnifferSend/main/Kconfig.projbuild
```kconfig
menu "Example Configuration"

menu "STA Configuration"
    config ESP_STA_SSID
        string "WiFi SSID"
        default "LJCG3"
        help
            SSID (network name) for the example to connect to.

    config ESP_STA_PASSWORD
        string "WiFi Password"
        default "87619099"
        help
            WiFi password (WPA or WPA2) for the example to use.

    config ESP_MAXIMUM_RETRY
        int "Maximum retry"
        default 10
        help
            Set the Maximum retry to avoid station reconnecting to the AP unlimited when the AP is really inexistent.
endmenu

menu "AP Configuration"
    config ESP_AP_SSID
        string "WiFi SSID"
        default "myssid"
        help
            SSID (network name) for the example to connect to.

    config ESP_AP_PASSWORD
        string "WiFi Password"
        default "mypassword"
        help
            WiFi password (WPA or WPA2) for the example to use.
    config ESP_AP_CHANNEL
        int "WiFi Channel"
        range 1 13
        default 1
        help
            WiFi channel (network channel) for the example to use.

    config ESP_MAX_STA_CONN
        int "Maximal STA connections"
        default 4
        help
            Max number of the STA connects to AP.
endmenu

menu "OTA Server Configuration"

	config CONNECT_ORIGINAL_AP
		bool "Connect to the original AP"
		default n
		help
			Connect to the original AP of old SDK

	config SERVER_IP
		string "HTTP Server IP"
		default "52.82.44.25"
		help
			HTTP Server IP to download the image file from.
			See example README.md for details.

	config SERVER_PORT
		string "HTTP Server Port"
		default "9090"
		help
			HTTP Server port to connect to.
			Should be chosen not to conflict with any other port used
			on the system.

	config EXAMPLE_FILENAME
		string "HTTP GET Filename"
		default "rtos_scansnifferSend.bin"
		help
			Filename of the app image file to download for
			the OTA update.

endmenu

endmenu
```
